## boards/shields/eyelash_sofle/Kconfig.shield
```kconfig
# No whitespace after the comma or in your part name!
config BOARD_EYELASH_SOFLE_LEFT
    def_bool $(shields_list_contains,eyelash_sofle_left)

# No whitespace after the comma or in your part name!
config BOARD_EYELASH_SOFLE_RIGHT
    def_bool $(shields_list_contains,eyelash_sofle_right)
```
